/dts-v1/;

/ {

	__fixups__ {
		accdet = "/fragment@15:target:0";
		afe = "/fragment@24:target:0";
		auxadc = "/fragment@30:target:0", "/fragment@31/__overlay__:io-channels:0";
		camera_af_hw_node = "/fragment@69:target:0";
		charger = "/fragment@14:target:0";
		chosen = "/fragment@2:target:0", "/fragment@14/__overlay__:bootmode:0";
		consys = "/fragment@19:target:0";
		dsi_te = "/fragment@51:target:0";
		gpio = "/fragment@43:target:0";
		gpio_usage_mapping = "/fragment@42:target:0";
		i2c0 = "/fragment@6:target:0", "/fragment@33:target:0";
		i2c1 = "/fragment@34:target:0";
		i2c2 = "/fragment@10:target:0", "/fragment@35:target:0";
		i2c3 = "/fragment@7:target:0", "/fragment@11:target:0", "/fragment@36:target:0";
		i2c4 = "/fragment@37:target:0";
		i2c5 = "/fragment@0:target:0", "/fragment@13:target:0", "/fragment@38:target:0";
		i2c6 = "/fragment@12:target:0", "/fragment@39:target:0";
		i2c7 = "/fragment@40:target:0";
		i2c8 = "/fragment@41:target:0";
		irq_nfc = "/fragment@47:target:0";
		irtx_pwm = "/fragment@20:target:0";
		kd_camera_hw1 = "/fragment@62:target:0", "/fragment@68:target:0";
		keypad = "/fragment@16:target:0", "/fragment@64:target:0";
		main_pmic = "/fragment@52:target:0";
		md1_sim1_hot_plug_eint = "/fragment@53:target:0";
		md1_sim2_hot_plug_eint = "/fragment@54:target:0";
		md_auxadc = "/fragment@31:target:0";
		mrdump_ext_rst = "/fragment@44:target:0";
		msdc1_ins = "/fragment@46:target:0";
		mt_pmic_vcama1_ldo_reg = "/fragment@55:target:0", "/fragment@62/__overlay__:vcama-supply:0", "/fragment@62/__overlay__:vcama_main2-supply:0", "/fragment@68/__overlay__:cam0_vcama-supply:0", "/fragment@68/__overlay__:cam2_vcama-supply:0";
		mt_pmic_vcama2_ldo_reg = "/fragment@56:target:0", "/fragment@62/__overlay__:vcama_sub-supply:0", "/fragment@68/__overlay__:cam1_vcama-supply:0";
		mt_pmic_vcamd_ldo_reg = "/fragment@59:target:0", "/fragment@62/__overlay__:vcamd_main2-supply:0", "/fragment@68/__overlay__:cam1_vcamd-supply:0";
		mt_pmic_vcamio_ldo_reg = "/fragment@60:target:0", "/fragment@62/__overlay__:vcamio-supply:0", "/fragment@62/__overlay__:vcamio_sub-supply:0", "/fragment@62/__overlay__:vcamio_main2-supply:0", "/fragment@68/__overlay__:cam0_vcamio-supply:0", "/fragment@68/__overlay__:cam1_vcamio-supply:0";
		mt_pmic_vio18_ldo_reg = "/fragment@7/__overlay__/abov_sar@20:cap_svdd-supply:0";
		mt_pmic_vio28_ldo_reg = "/fragment@7/__overlay__/abov_sar@20:cap_vdd-supply:0";
		mt_pmic_vldo28_ldo_reg = "/fragment@61:target:0", "/fragment@62/__overlay__:vcamaf-supply:0", "/fragment@62/__overlay__:vcamaf_sub-supply:0", "/fragment@62/__overlay__:vcamaf_main2-supply:0", "/fragment@63/__overlay__:vtouch-supply:0", "/fragment@69/__overlay__:camaf_m1_pmic-supply:0", "/fragment@69/__overlay__:camaf_m2_pmic-supply:0", "/fragment@69/__overlay__:camaf_m3_pmic-supply:0";
		mt_pmic_vsim1_ldo_reg = "/fragment@57:target:0";
		mt_pmic_vsim2_ldo_reg = "/fragment@58:target:0";
		mtkfb = "/fragment@23:target:0";
		ocp81375 = "/fragment@66:target:0";
		odm = "/fragment@5:target:0", "/fragment@29:target:0";
		pio = "/fragment@0/__overlay__/rt-swchg@53:rt,intr_gpio:0", "/fragment@0/__overlay__/rt-swchg@53:tc30_dm_gpio:0", "/fragment@0/__overlay__/rt-swchg@53:hvdcp20_dp_gpio:0", "/fragment@3/__overlay__/fingerprint@0:interrupt-parent:0", "/fragment@3/__overlay__/fingerprint@0:irq-gpio-std:0", "/fragment@3/__overlay__/fingerprint@0:reset-gpio-std:0", "/fragment@3/__overlay__/fingerprint@0:tran,gpio_pwr-std:0", "/fragment@4:target:0", "/fragment@5/__overlay__/swtp:interrupt-parent:0", "/fragment@5/__overlay__/swtp:deb-gpios:0", "/fragment@7/__overlay__/abov_sar@20:abov,irq-gpio-std:0", "/fragment@9:target:0", "/fragment@11/__overlay__/pn544@28:nxp,pn544-irq:0", "/fragment@11/__overlay__/pn544@28:nxp,pn544-ven:0", "/fragment@11/__overlay__/pn544@28:nxp,pn544-fw-dwnld:0", "/fragment@11/__overlay__/pn544@28:nxp,clkreq_gpio:0", "/fragment@12/__overlay__/wusb3801_type_c_port0:interrupt-parent:0", "/fragment@12/__overlay__/wusb3801_type_c_port0:wusb,intr_gpio:0", "/fragment@12/__overlay__/wusb3801_type_c_port0:wusb,intr_gpio_num:0", "/fragment@12/__overlay__/wusb3801_type_c_port0:id-gpio:0", "/fragment@12/__overlay__/husb320@21:interrupt-parent:0", "/fragment@12/__overlay__/husb320@21:husb320,int-gpio:0", "/fragment@13/__overlay__/eta6937@6A:intr_gpio:0", "/fragment@17:target:0", "/fragment@18:target:0", "/fragment@21:target:0", "/fragment@22:target:0", "/fragment@25:target:0", "/fragment@27/__overlay__:interrupt-parent:0", "/fragment@28:target:0", "/fragment@29/__overlay__/otg_iddig:interrupt-parent:0", "/fragment@29/__overlay__/otg_iddig:deb-gpios:0", "/fragment@42/__overlay__:GPIO_SIM2_HOT_PLUG:0", "/fragment@42/__overlay__:GPIO_SIM1_HOT_PLUG:0", "/fragment@42/__overlay__:GPIO_SIM2_SIO:0", "/fragment@42/__overlay__:GPIO_SIM2_SRST:0", "/fragment@42/__overlay__:GPIO_SIM2_SCLK:0", "/fragment@42/__overlay__:GPIO_SIM1_SCLK:0", "/fragment@42/__overlay__:GPIO_SIM1_SRST:0", "/fragment@42/__overlay__:GPIO_SIM1_SIO:0", "/fragment@44/__overlay__:interrupt-parent:0", "/fragment@44/__overlay__:deb-gpios:0", "/fragment@45/__overlay__:interrupt-parent:0", "/fragment@46/__overlay__:interrupt-parent:0", "/fragment@46/__overlay__:deb-gpios:0", "/fragment@47/__overlay__:interrupt-parent:0", "/fragment@48/__overlay__:interrupt-parent:0", "/fragment@49/__overlay__:interrupt-parent:0", "/fragment@50/__overlay__:interrupt-parent:0", "/fragment@51/__overlay__:interrupt-parent:0", "/fragment@52/__overlay__:interrupt-parent:0", "/fragment@65:target:0", "/fragment@67:target:0";
		pmic_clock_buffer_ctrl = "/fragment@32:target:0";
		reserved_memory = "/fragment@1:target:0";
		rt9465_slave_chr = "/fragment@50:target:0";
		smart_pa = "/fragment@49:target:0";
		spi0 = "/fragment@3:target:0";
		spi2 = "/fragment@26:target:0";
		spi5 = "/fragment@8:target:0";
		subpmic_pmu_eint = "/fragment@48:target:0";
		touch = "/fragment@27:target:0", "/fragment@45:target:0", "/fragment@63:target:0";
	};

	__local_fixups__ {

		fragment@16 {

			__overlay__ {
				pinctrl-0 = <0x0>;
			};
		};

		fragment@19 {

			__overlay__ {
				pinctrl-0 = <0x0>;
				pinctrl-1 = <0x0>;
				pinctrl-2 = <0x0>;
				pinctrl-3 = <0x0>;
			};
		};

		fragment@20 {

			__overlay__ {
				pinctrl-0 = <0x0>;
				pinctrl-1 = <0x0>;
			};
		};

		fragment@23 {

			__overlay__ {
				pinctrl-0 = <0x0>;
				pinctrl-1 = <0x0>;
				pinctrl-10 = <0x0>;
				pinctrl-2 = <0x0>;
				pinctrl-3 = <0x0>;
				pinctrl-4 = <0x0>;
				pinctrl-5 = <0x0>;
				pinctrl-6 = <0x0>;
				pinctrl-7 = <0x0>;
				pinctrl-8 = <0x0>;
				pinctrl-9 = <0x0>;
			};
		};

		fragment@24 {

			__overlay__ {
				pinctrl-20 = <0x0>;
				pinctrl-21 = <0x0>;
			};
		};

		fragment@27 {

			__overlay__ {
				pinctrl-0 = <0x0>;
				pinctrl-1 = <0x0>;
				pinctrl-2 = <0x0>;
				pinctrl-3 = <0x0>;
				pinctrl-4 = <0x0>;
				pinctrl-5 = <0x0>;
				pinctrl-6 = <0x0>;
			};
		};

		fragment@3 {

			__overlay__ {

				fingerprint@0 {
					pinctrl-0 = <0x0>;
					pinctrl-1 = <0x0>;
					pinctrl-2 = <0x0>;
					pinctrl-3 = <0x0>;
					pinctrl-4 = <0x0>;
				};
			};
		};

		fragment@66 {

			__overlay__ {
				pinctrl-0 = <0x0>;
				pinctrl-1 = <0x0>;
				pinctrl-2 = <0x0>;
			};
		};

		fragment@68 {

			__overlay__ {
				pinctrl-0 = <0x0>;
				pinctrl-1 = <0x0>;
				pinctrl-10 = <0x0>;
				pinctrl-11 = <0x0>;
				pinctrl-12 = <0x0>;
				pinctrl-13 = <0x0>;
				pinctrl-14 = <0x0>;
				pinctrl-15 = <0x0>;
				pinctrl-16 = <0x0>;
				pinctrl-17 = <0x0>;
				pinctrl-18 = <0x0>;
				pinctrl-19 = <0x0>;
				pinctrl-2 = <0x0>;
				pinctrl-20 = <0x0>;
				pinctrl-21 = <0x0>;
				pinctrl-22 = <0x0>;
				pinctrl-23 = <0x0>;
				pinctrl-24 = <0x0>;
				pinctrl-25 = <0x0>;
				pinctrl-3 = <0x0>;
				pinctrl-4 = <0x0>;
				pinctrl-5 = <0x0>;
				pinctrl-6 = <0x0>;
				pinctrl-7 = <0x0>;
				pinctrl-8 = <0x0>;
				pinctrl-9 = <0x0>;
			};
		};

		fragment@8 {

			__overlay__ {
				pinctrl-0 = <0x0>;
			};
		};
	};

	__symbols__ {
		aud_pins_extamp_high = "/fragment@25/__overlay__/aud_pins_extamp_high";
		aud_pins_extamp_low = "/fragment@25/__overlay__/aud_pins_extamp_low";
		camera0_mclk_2mA = "/fragment@67/__overlay__/camera0_mclk_2mA@gpio99";
		camera0_mclk_4mA = "/fragment@67/__overlay__/camera0_mclk_4mA@gpio99";
		camera0_mclk_6mA = "/fragment@67/__overlay__/camera0_mclk_6mA@gpio99";
		camera0_mclk_8mA = "/fragment@67/__overlay__/camera0_mclk_8mA@gpio99";
		camera0_mclk_off = "/fragment@67/__overlay__/camera0_mclk_gpio_mode@gpio99";
		camera0_rst_high = "/fragment@67/__overlay__/camera0_rst_output_high@gpio101";
		camera0_rst_low = "/fragment@67/__overlay__/camera0_rst_output_low@gpio101";
		camera0_vcamd_off = "/fragment@67/__overlay__/camera0_vcamd_output_low@gpio179";
		camera0_vcamd_on = "/fragment@67/__overlay__/camera0_vcamd_output_high@gpio179";
		camera1_mclk_2mA = "/fragment@67/__overlay__/camera1_mclk_2mA@gpio100";
		camera1_mclk_4mA = "/fragment@67/__overlay__/camera1_mclk_4mA@gpio100";
		camera1_mclk_6mA = "/fragment@67/__overlay__/camera1_mclk_6mA@gpio100";
		camera1_mclk_8mA = "/fragment@67/__overlay__/camera1_mclk_8mA@gpio100";
		camera1_mclk_off = "/fragment@67/__overlay__/camera1_mclk_gpio_mode@gpio100";
		camera1_rst_high = "/fragment@67/__overlay__/camera1_rst_output_high@gpio102";
		camera1_rst_low = "/fragment@67/__overlay__/camera1_rst_output_low@gpio102";
		camera2_mclk_2mA = "/fragment@67/__overlay__/camera2_mclk_2mA@gpio111";
		camera2_mclk_4mA = "/fragment@67/__overlay__/camera2_mclk_4mA@gpio111";
		camera2_mclk_6mA = "/fragment@67/__overlay__/camera2_mclk_6mA@gpio111";
		camera2_mclk_8mA = "/fragment@67/__overlay__/camera2_mclk_8mA@gpio111";
		camera2_mclk_off = "/fragment@67/__overlay__/camera2_mclk_gpio_mode@gpio111";
		camera2_pdn_high = "/fragment@67/__overlay__/camera2_pdn_output_high@gpio110";
		camera2_pdn_low = "/fragment@67/__overlay__/camera2_pdn_output_low@gpio110";
		camera2_rst_high = "/fragment@67/__overlay__/camera2_rst_output_high@gpio109";
		camera2_rst_low = "/fragment@67/__overlay__/camera2_rst_output_low@gpio109";
		camera_main_af_mtk = "/fragment@35/__overlay__/camera_main_af@0c";
		camera_main_eeprom_mtk = "/fragment@35/__overlay__/camera_main_eeprom@50";
		camera_main_mtk = "/fragment@35/__overlay__/camera_main@1a";
		camera_main_two_eeprom_mtk = "/fragment@36/__overlay__/camera_main_two_eeprom@50";
		camera_main_two_mtk = "/fragment@36/__overlay__/camera_main_two@10";
		camera_pins_default = "/fragment@67/__overlay__/camdefault";
		camera_sub_eeprom_mtk = "/fragment@37/__overlay__/camera_sub_eeprom@52";
		camera_sub_mtk = "/fragment@37/__overlay__/camera_sub@2d";
		ccu_sensor_i2c_2_hw_mtk = "/fragment@35/__overlay__/ccu_sensor_i2c_2_hw@11";
		ccu_sensor_i2c_4_hw_mtk = "/fragment@37/__overlay__/ccu_sensor_i2c_4_hw@12";
		consys_pins_default = "/fragment@18/__overlay__/consys_default";
		ctp_pins_default = "/fragment@28/__overlay__/eint0default";
		ctp_pins_eint_as_int = "/fragment@28/__overlay__/eint@0";
		ctp_pins_eint_output0 = "/fragment@28/__overlay__/eintoutput0";
		ctp_pins_eint_output1 = "/fragment@28/__overlay__/eintoutput1";
		ctp_pins_rst_output0 = "/fragment@28/__overlay__/rstoutput0";
		ctp_pins_rst_output1 = "/fragment@28/__overlay__/rstoutput1";
		ctp_pins_spi_mode = "/fragment@28/__overlay__/spimode_default";
		fingerprint_default = "/fragment@4/__overlay__/fingerprint_default";
		fingerprint_eint = "/fragment@4/__overlay__/gpio_eint";
		fingerprint_eint_pull_down = "/fragment@4/__overlay__/gpio_eint_pull_down";
		fingerprint_rst_one = "/fragment@4/__overlay__/rst_out_one";
		fingerprint_rst_zero = "/fragment@4/__overlay__/rst_out_zero";
		gpslna_pins_init = "/fragment@18/__overlay__/gpslna@0";
		gpslna_pins_oh = "/fragment@18/__overlay__/gpslna@1";
		gpslna_pins_ol = "/fragment@18/__overlay__/gpslna@2";
		irtx_gpio_led_default = "/fragment@21/__overlay__/irtx_gpio_led_def@gpio12";
		irtx_gpio_led_set = "/fragment@21/__overlay__/irtx_gpio_led_set@gpio12";
		kpd_pins_default = "/fragment@17/__overlay__/kpdgpiodefault";
		led0 = "/fragment@5/__overlay__/led@0";
		led1 = "/fragment@5/__overlay__/led@1";
		led2 = "/fragment@5/__overlay__/led@2";
		led3 = "/fragment@5/__overlay__/led@3";
		led4 = "/fragment@5/__overlay__/led@4";
		led5 = "/fragment@5/__overlay__/led@5";
		led6 = "/fragment@5/__overlay__/led@6";
		mtkfb_pins_6382_rst_out0 = "/fragment@22/__overlay__/6382_rst_out0_gpio";
		mtkfb_pins_6382_rst_out1 = "/fragment@22/__overlay__/6382_rst_out1_gpio";
		mtkfb_pins_lcd_bias_enn0 = "/fragment@22/__overlay__/lcd_bias_enn0_gpio";
		mtkfb_pins_lcd_bias_enn1 = "/fragment@22/__overlay__/lcd_bias_enn1_gpio";
		mtkfb_pins_lcd_bias_enp0 = "/fragment@22/__overlay__/lcd_bias_enp0_gpio";
		mtkfb_pins_lcd_bias_enp1 = "/fragment@22/__overlay__/lcd_bias_enp1_gpio";
		mtkfb_pins_lcd_disp_pwm0 = "/fragment@22/__overlay__/lcd_disp_pwm0_gpio";
		mtkfb_pins_lcd_disp_pwm1 = "/fragment@22/__overlay__/lcd_disp_pwm1_gpio";
		mtkfb_pins_lcm_dsi_te = "/fragment@22/__overlay__/lcm_dsi_te";
		mtkfb_pins_lcm_rst_out0_gpio = "/fragment@22/__overlay__/lcm_rst_out0_gpio";
		mtkfb_pins_lcm_rst_out1_gpio = "/fragment@22/__overlay__/lcm_rst_out1_gpio";
		nfc_mtk = "/fragment@36/__overlay__/nfc@08";
		ocp81375_pins_default = "/fragment@65/__overlay__/ocp81375default";
		ocp81375_pins_hwen_high = "/fragment@65/__overlay__/ocp81375hwen_high";
		ocp81375_pins_hwen_low = "/fragment@65/__overlay__/ocp81375hwen_low";
		otg_iddig = "/fragment@29/__overlay__/otg_iddig";
		pn544 = "/fragment@11/__overlay__/pn544@28";
		slave_charger_mtk = "/fragment@40/__overlay__/slave_charger@4b";
		spislv_pins_default = "/fragment@9/__overlay__/spislv_mode_default";
		subpmic_pmu_mtk = "/fragment@38/__overlay__/subpmic_pmu@34";
		swtp = "/fragment@5/__overlay__/swtp";
		tran_battery0 = "/fragment@5/__overlay__/tran_battery";
		usb_type_c_mtk = "/fragment@38/__overlay__/usb_type_c@4e";
		vibrator0 = "/fragment@5/__overlay__/vibrator@0";
		wusb3801_typec = "/fragment@12/__overlay__/wusb3801_type_c_port0";
	};

	fragment@0 {
		target = <0xffffffff>;

		__overlay__ {
			#address-cells = <0x1>;
			#size-cells = <0x0>;

			rt-swchg@53 {
				compatible = "richtek,swchg";
				hvdcp20_dp_gpio = <0xffffffff 0x2a 0x0>;
				reg = <0x53>;
				rt,intr_gpio = <0xffffffff 0x7 0x0>;
				rt,intr_gpio_num = <0x7>;
				status = "okay";
				tc30_dm_gpio = <0xffffffff 0xa0 0x0>;

				rt9471 {
					aicr = <0x7a120>;
					chg_alias_name = "rt9471_chg";
					chg_name = "primary_chg";
					cv = <0x42d560>;
					en_qon_rst;
					en_safe_tmr;
					en_te;
					ichg = <0xf4240>;
					ieoc = <0x30d40>;
					interrupt-names = "wdt", "chg_mivr", "vbus_gd", "bc12_done", "detach", "vac_ov", "otg_fault", "chg_rdy", "chg_done", "aicc_done", "pe_done", "chg_tout", "rechg", "chg_batov";
					mivr = <0x432380>;
					mivr_track = <0x0>;
					rm-name = "rt9471";
					rm-slave-addr = [53];
					safe_tmr = <0xa>;
					vac_ovp = <0xa65220>;
					wdt = <0x28>;
				};
			};
		};
	};

	fragment@1 {
		target = <0xffffffff>;

		__overlay__ {

			reserve-memory-scp_share {
				alignment = <0x0 0x1000000>;
				alloc-ranges = <0x0 0x40000000 0x0 0x50000000>;
				compatible = "mediatek,reserve-memory-scp_share";
				no-map;
				size = <0x0 0xd00000>;
			};
		};
	};

	fragment@10 {
		target = <0xffffffff>;

		__overlay__ {
			clock-frequency = <0x61a80>;

			mtk-usb@60 {
				compatible = "mediatek,mtk-usb";
				reg = <0x60>;
				status = "okay";
			};
		};
	};

	fragment@11 {
		target = <0xffffffff>;

		__overlay__ {
			clock-frequency = <0x61a80>;

			pn544@28 {
				compatible = "nxp,pn544";
				nxp,clkreq_gpio = <0xffffffff 0xb 0x0>;
				nxp,pn544-fw-dwnld = <0xffffffff 0x18 0x0>;
				nxp,pn544-irq = <0xffffffff 0x9 0x0>;
				nxp,pn544-ven = <0xffffffff 0x9f 0x0>;
				phandle = <0x49>;
				reg = <0x28>;
				status = "okay";
			};
		};
	};

	fragment@12 {
		target = <0xffffffff>;

		__overlay__ {
			clock-frequency = <0x61a80>;

			husb320@21 {
				compatible = "hynetek,husb320";
				gpio-controller;
				husb320,autosink-threshold = <0x1>;
				husb320,cc-debounce-time = <0x3>;
				husb320,drp-duty-time = <0x0>;
				husb320,drp-toggle-time = <0x1>;
				husb320,host-current = <0x2>;
				husb320,init-mode = <0x14>;
				husb320,int-gpio = <0xffffffff 0x29 0x0>;
				husb320,int-gpio_num = <0x29>;
				interrupt-parent = <0xffffffff>;
				reg = <0x21>;
				status = "okay";
			};

			wusb3801_type_c_port0 {
				compatible = "mediatek,usb_type_c";
				id-gpio = <0xffffffff 0x29 0x0>;
				interrupt-name = "wusb3801_int_irq";
				interrupt-parent = <0xffffffff>;
				phandle = <0x4a>;
				reg = <0x60>;
				status = "okay";
				wusb,intr_gpio = <0xffffffff 0x29 0x0>;
				wusb,intr_gpio_num = <0xffffffff 0x29 0x0>;
				wusb-tcpc,name = "type_c_port0";
				wusb-tcpc,notifier_supply_num = <0x2>;
				wusb-tcpc,role_def = <0x5>;
				wusb-tcpc,rp_level = <0x0>;
				wusb3801,drp-toggle-time = <0x0>;
				wusb3801,host-current = <0x1>;
				wusb3801,init-mode = <0x20>;
			};
		};
	};

	fragment@13 {
		target = <0xffffffff>;

		__overlay__ {

			eta6937@6A {
				charger_name = "secondary_chg";
				compatible = "mediatek,eta6937";
				intr_gpio = <0xffffffff 0xb2 0x0>;
				reg = <0x6a>;
				status = "okay";
			};
		};
	};

	fragment@14 {
		target = <0xffffffff>;

		__overlay__ {
			ac_charger_current = <0x1e8480>;
			ac_charger_input_current = <0x249f00>;
			algorithm_name = "DualSwitchCharging";
			apple_1_0a_charger_current = <0x9eb10>;
			apple_2_1a_charger_current = <0x10c8e0>;
			battery_cv = <0x432380>;
			bootmode = <0xffffffff>;
			cable_imp_threshold = <0x2bb>;
			charging_host_charger_current = <0x16e360>;
			chg1_ta_ac_charger_current = <0x16e360>;
			chg2_ta_ac_charger_current = <0x0>;
			compatible = "mediatek,charger";
			disable_pd_dual;
			dual_polling_ieoc = <0x249f0>;
			enable_dynamic_mivr;
			enable_hvdcp20;
			enable_min_charge_temp;
			enable_pe_2;
			enable_pe_plus;
			enable_sw_jeita;
			enable_tc30;
			enable_type_c;
			high_temp_to_enter_pe40 = <0x27>;
			high_temp_to_leave_pe40 = <0x2e>;
			jeita_temp_above_t4_cv = <0x3e8fa0>;
			jeita_temp_below_t0_cv = <0x432380>;
			jeita_temp_t0_to_t1_cv = <0x432380>;
			jeita_temp_t1_to_t2_cv = <0x432380>;
			jeita_temp_t2_to_t3_cv = <0x432380>;
			jeita_temp_t3_to_t4_cv = <0x3e8fa0>;
			low_temp_to_enter_pe40 = <0x10>;
			low_temp_to_leave_pe40 = <0xa>;
			max_charge_temp = <0x35>;
			max_charge_temp_minus_x_degree = <0x34>;
			max_charger_voltage = <0x632ea0>;
			max_dmivr_charger_current = <0x155cc0>;
			min_charge_temp = <0x0>;
			min_charge_temp_plus_x_degree = <0x2>;
			min_charger_voltage = <0x4630c0>;
			min_charger_voltage_1 = <0x432380>;
			min_charger_voltage_2 = <0x401640>;
			non_std_ac_charger_current = <0xf4240>;
			pe20_ichg_level_threshold = <0xf4240>;
			pe40_dual_charger_chg1_current = <0x1e8480>;
			pe40_dual_charger_chg2_current = <0x1e8480>;
			pe40_dual_charger_input_current = <0x2dc6c0>;
			pe40_r_cable_1a_lower = <0x206>;
			pe40_r_cable_2a_lower = <0x17f>;
			pe40_r_cable_3a_lower = <0xf5>;
			pe40_single_charger_current = <0x2dc6c0>;
			pe40_single_charger_input_current = <0x2dc6c0>;
			pe40_stop_battery_soc = <0x50>;
			pe_ichg_level_threshold = <0xf4240>;
			power_path_support;
			slave_mivr_diff = <0x186a0>;
			ta_9v_support;
			ta_ac_7v_input_current = <0x249f00>;
			ta_ac_9v_input_current = <0x2191c0>;
			ta_ac_charger_current = <0x33e140>;
			ta_start_battery_soc = <0x0>;
			ta_stop_battery_soc = <0x5a>;
			temp_neg_10_thres = <0x2>;
			temp_t0_thres = <0x0>;
			temp_t0_thres_plus_x_degree = <0x0>;
			temp_t1_thres = <0x1>;
			temp_t1_thres_plus_x_degree = <0x2>;
			temp_t2_thres = <0xf>;
			temp_t2_thres_plus_x_degree = <0xc>;
			temp_t3_thres = <0x2c>;
			temp_t3_thres_minus_x_degree = <0x2a>;
			temp_t4_thres = <0x37>;
			temp_t4_thres_minus_x_degree = <0x32>;
			usb_charger_current = <0x7a120>;
			usb_charger_current_configured = <0x7a120>;
			usb_charger_current_suspend = <0x0>;
			usb_charger_current_unconfigured = <0x11170>;
			vbat_cable_imp_threshold = <0x3b8260>;
		};
	};

	fragment@15 {
		target = <0xffffffff>;

		__overlay__ {
			accdet-mic-mode = <0x1>;
			accdet-mic-vol = <0x6>;
			accdet-plugout-debounce = <0x1>;
			headset-eint-level-pol = <0x8>;
			headset-four-key-threshold = <0x0 0x3a 0x79 0xc0 0x190>;
			headset-mode-setting = <0x500 0x500 0x1 0x1f0 0x800 0x800 0x20 0x44>;
			headset-three-key-threshold = <0x0 0x50 0xdc 0x190>;
			headset-three-key-threshold-CDD = <0x0 0x79 0xc0 0x258>;
			status = "okay";
		};
	};

	fragment@16 {
		target = <0xffffffff>;

		__overlay__ {
			pinctrl-0 = <0x7>;
			pinctrl-names = "default";
		};
	};

	fragment@17 {
		target = <0xffffffff>;

		__overlay__ {

			kpdgpiodefault {
				phandle = <0x7>;

				pins_cmd_dat {
					bias-pull-up = <0x66>;
					input-enable;
					input-schmitt-enable;
					pinmux = <0x5d01>;
				};
			};
		};
	};

	fragment@18 {
		target = <0xffffffff>;

		__overlay__ {

			consys_default {
				phandle = <0x8>;
			};

			gpslna@0 {
				phandle = <0x9>;

				pins_cmd_dat {
					bias-disable;
					output-low;
					pinmux = <0x5e00>;
					slew-rate = <0x0>;
				};
			};

			gpslna@1 {
				phandle = <0xa>;

				pins_cmd_dat {
					output-high;
					pinmux = <0x5e00>;
					slew-rate = <0x1>;
				};
			};

			gpslna@2 {
				phandle = <0xb>;

				pins_cmd_dat {
					output-low;
					pinmux = <0x5e00>;
					slew-rate = <0x1>;
				};
			};
		};
	};

	fragment@19 {
		target = <0xffffffff>;

		__overlay__ {
			pinctrl-0 = <0x8>;
			pinctrl-1 = <0x9>;
			pinctrl-2 = <0xa>;
			pinctrl-3 = <0xb>;
			pinctrl-names = "default", "gps_lna_state_init", "gps_lna_state_oh", "gps_lna_state_ol";
			status = "okay";
		};
	};

	fragment@2 {
		target = <0xffffffff>;

		__overlay__ {
			atag,videolfb-fb_base_h = <0x0>;
			atag,videolfb-fb_base_l = "~`P";
			atag,videolfb-fps = <0x1770>;
			atag,videolfb-islcm_inited = <0x0>;
			atag,videolfb-islcmfound = <0x1>;
			atag,videolfb-lcmname = "ili7807s_fhdp_dsi_vdo_txd";
			atag,videolfb-vramSize = <0x17e8000>;
		};
	};

	fragment@20 {
		target = <0xffffffff>;

		__overlay__ {
			pinctrl-0 = <0xc>;
			pinctrl-1 = <0xd>;
			pinctrl-names = "irtx_gpio_led_default", "irtx_gpio_led_set";
			status = "okay";
		};
	};

	fragment@21 {
		target = <0xffffffff>;

		__overlay__ {

			irtx_gpio_led_def@gpio12 {
				phandle = <0xc>;

				pins_cmd_dat {
					bias-disable;
					input-schmitt-enable = <0x0>;
					output-low;
					pinmux = <0xc00>;
					slew-rate = <0x1>;
				};
			};

			irtx_gpio_led_set@gpio12 {
				phandle = <0xd>;

				pins_cmd_dat {
					output-high;
					pinmux = <0xc01>;
					slew-rate = <0x1>;
				};
			};
		};
	};

	fragment@22 {
		target = <0xffffffff>;

		__overlay__ {

			6382_rst_out0_gpio {
				phandle = <0x18>;

				pins_cmd_dat {
					output-low;
					pinmux = <0x1300>;
					slew-rate = <0x1>;
				};
			};

			6382_rst_out1_gpio {
				phandle = <0x17>;

				pins_cmd_dat {
					output-high;
					pinmux = <0x1300>;
					slew-rate = <0x1>;
				};
			};

			lcd_bias_enn0_gpio {
				phandle = <0x13>;

				pins_cmd_dat {
					output-low;
					pinmux = <0xa500>;
					slew-rate = <0x1>;
				};
			};

			lcd_bias_enn1_gpio {
				phandle = <0x12>;

				pins_cmd_dat {
					output-high;
					pinmux = <0xa500>;
					slew-rate = <0x1>;
				};
			};

			lcd_bias_enp0_gpio {
				phandle = <0x11>;

				pins_cmd_dat {
					output-low;
					pinmux = <0xa900>;
					slew-rate = <0x1>;
				};
			};

			lcd_bias_enp1_gpio {
				phandle = <0x10>;

				pins_cmd_dat {
					output-high;
					pinmux = <0xa900>;
					slew-rate = <0x1>;
				};
			};

			lcd_disp_pwm0_gpio {
				phandle = <0x16>;

				pins_cmd_dat {
					output-low;
					pinmux = <0x2b00>;
					slew-rate = <0x1>;
				};
			};

			lcd_disp_pwm1_gpio {
				phandle = <0x15>;

				pins_cmd_dat {
					output-high;
					pinmux = <0x2b00>;
					slew-rate = <0x1>;
				};
			};

			lcm_dsi_te {
				phandle = <0x14>;

				pins_cmd_dat {
					pinmux = <0x2c01>;
				};
			};

			lcm_rst_out0_gpio {
				phandle = <0xf>;

				pins_cmd_dat {
					output-low;
					pinmux = <0x2d00>;
					slew-rate = <0x1>;
				};
			};

			lcm_rst_out1_gpio {
				phandle = <0xe>;

				pins_cmd_dat {
					output-high;
					pinmux = <0x2d00>;
					slew-rate = <0x1>;
				};
			};
		};
	};

	fragment@23 {
		target = <0xffffffff>;

		__overlay__ {
			pinctrl-0 = <0xe>;
			pinctrl-1 = <0xf>;
			pinctrl-10 = <0x18>;
			pinctrl-2 = <0x10>;
			pinctrl-3 = <0x11>;
			pinctrl-4 = <0x12>;
			pinctrl-5 = <0x13>;
			pinctrl-6 = <0x14>;
			pinctrl-7 = <0x15>;
			pinctrl-8 = <0x16>;
			pinctrl-9 = <0x17>;
			pinctrl-names = "lcm_rst_out1_gpio", "lcm_rst_out0_gpio", "lcd_bias_enp1_gpio", "lcd_bias_enp0_gpio", "lcd_bias_enn1_gpio", "lcd_bias_enn0_gpio", "mode_te_te", "lcd_disp_pwm1_gpio", "lcd_disp_pwm0_gpio", "6382_rst_out1_gpio", "6382_rst_out0_gpio";
			status = "okay";
		};
	};

	fragment@24 {
		target = <0xffffffff>;

		__overlay__ {
			pinctrl-20 = <0x19>;
			pinctrl-21 = <0x1a>;
			pinctrl-names = "aud_clk_mosi_off", "aud_clk_mosi_on", "aud_clk_miso_off", "aud_clk_miso_on", "aud_dat_mosi_off", "aud_dat_mosi_on", "aud_dat_miso_off", "aud_dat_miso_on", "aud_gpio_i2s0_off", "aud_gpio_i2s0_on", "aud_gpio_i2s1_off", "aud_gpio_i2s1_on", "aud_gpio_i2s2_off", "aud_gpio_i2s2_on", "aud_gpio_i2s3_off", "aud_gpio_i2s3_on", "vow_dat_miso_off", "vow_dat_miso_on", "vow_clk_miso_off", "vow_clk_miso_on", "extamp-pullhigh", "extamp-pulllow";
		};
	};

	fragment@25 {
		target = <0xffffffff>;

		__overlay__ {

			aud_pins_extamp_high {
				phandle = <0x19>;

				pins_cmd_dat {
					output-high;
					pinmux = <0x9e00>;
					slew-rate = <0x1>;
				};
			};

			aud_pins_extamp_low {
				phandle = <0x1a>;

				pins_cmd_dat {
					output-low;
					pinmux = <0x9e00>;
					slew-rate = <0x1>;
				};
			};
		};
	};

	fragment@26 {
		target = <0xffffffff>;

		__overlay__ {
			#address-cells = <0x1>;
			#size-cells = <0x0>;
			status = "okay";

			focaltech_spi1@1 {
				compatible = "focaltech,fts";
				reg = <0x0>;
				spi-max-frequency = <0x5b8d80>;
			};

			focaltech_spi@0 {
				compatible = "mediatek,cap_touch";
				reg = <0x0>;
				spi-max-frequency = <0x5b8d80>;
			};
		};
	};

	fragment@27 {
		target = <0xffffffff>;

		__overlay__ {
			interrupt-parent = <0xffffffff>;
			interrupts = <0x1 0x2 0x1 0x0>;
			pinctrl-0 = <0x1b>;
			pinctrl-1 = <0x1c>;
			pinctrl-2 = <0x1d>;
			pinctrl-3 = <0x1e>;
			pinctrl-4 = <0x1f>;
			pinctrl-5 = <0x20>;
			pinctrl-6 = <0x21>;
			pinctrl-names = "default", "state_eint_as_int", "state_eint_output0", "state_eint_output1", "state_rst_output0", "state_rst_output1", "state_spi_mode";
			status = "okay";
			tpd-filter-custom-prameters = <0x0 0x0 0x0 0x0 0x0 0x0 0x0 0x0 0x0 0x0 0x0 0x0>;
			tpd-filter-custom-speed = <0x0 0x0 0x0>;
			tpd-filter-enable = <0x0>;
			tpd-filter-pixel-density = <0x92>;
			tpd-key-dim-local = <0x5a 0x373 0x64 0x28 0xe6 0x373 0x64 0x28 0x172 0x373 0x64 0x28 0x0 0x0 0x0 0x0>;
			tpd-key-local = <0x8b 0xac 0x9e 0x0>;
			tpd-key-num = <0x3>;
			tpd-max-touch-num = <0x5>;
			tpd-resolution = <0x438 0x99c>;
			use-tpd-button = <0x0>;
		};
	};

	fragment@28 {
		target = <0xffffffff>;

		__overlay__ {

			eint0default {
				phandle = <0x1b>;
			};

			eint@0 {
				phandle = <0x1c>;

				pins_cmd_dat {
					bias-disable;
					pinmux = <0x100>;
					slew-rate = <0x0>;
				};
			};

			eintoutput0 {
				phandle = <0x1d>;

				pins_cmd_dat {
					output-low;
					pinmux = <0x100>;
					slew-rate = <0x1>;
				};
			};

			eintoutput1 {
				phandle = <0x1e>;

				pins_cmd_dat {
					output-high;
					pinmux = <0x100>;
					slew-rate = <0x1>;
				};
			};

			rstoutput0 {
				phandle = <0x1f>;

				pins_cmd_dat {
					output-low;
					pinmux = <0x2400>;
					slew-rate = <0x1>;
				};
			};

			rstoutput1 {
				phandle = <0x20>;

				pins_cmd_dat {
					output-high;
					pinmux = <0x2400>;
					slew-rate = <0x1>;
				};
			};

			spimode_default {
				phandle = <0x21>;

				pins_cmd_dat {
					drive-strength = <0x4>;
					pinmux = <0x1c02 0x1902 0x1a02 0x1b02>;
				};
			};
		};
	};

	fragment@29 {
		target = <0xffffffff>;

		__overlay__ {

			otg_iddig {
				deb-gpios = <0xffffffff 0x29 0x0>;
				debounce = <0xfa00>;
				interrupt-parent = <0xffffffff>;
				interrupts = <0x29 0x2 0x29 0x0>;
				phandle = <0x4b>;
				status = "okay";
			};
		};
	};

	fragment@3 {
		target = <0xffffffff>;

		__overlay__ {

			fingerprint@0 {
				compatible = "tran_fp";
				debounce = <0x8 0x0>;
				interrupt-parent = <0xffffffff>;
				interrupts = <0x8 0x1 0x8 0x0>;
				irq-gpio = <0x8>;
				irq-gpio-std = <0xffffffff 0x8 0x0>;
				pinctrl-0 = <0x1>;
				pinctrl-1 = <0x2>;
				pinctrl-2 = <0x3>;
				pinctrl-3 = <0x4>;
				pinctrl-4 = <0x5>;
				pinctrl-names = "tran_fp_default", "tran_fp_pin_irq", "tran_fp_irq_pull_down", "tran_fp_reset_high", "tran_fp_reset_low";
				reg = <0x0>;
				reset-gpio = <0x14>;
				reset-gpio-std = <0xffffffff 0x14 0x0>;
				spi-max-frequency = <0x19bfcc0>;
				status = "okay";
				tran,gpio_pwr-std = <0xffffffff 0x27 0x0>;
			};
		};
	};

	fragment@30 {
		target = <0xffffffff>;

		__overlay__ {

			adc_channel@ {
				compatible = "mediatek,adc_channel";
				mediatek,adc_fdd_rf_params_dynamic_custom_ch = <0x3>;
				mediatek,temperature0 = <0x0>;
				mediatek,temperature1 = <0x1>;
				status = "okay";
			};
		};
	};

	fragment@31 {
		target = <0xffffffff>;

		__overlay__ {
			io-channels = <0xffffffff 0x3>;
		};
	};

	fragment@32 {
		target = <0xffffffff>;

		__overlay__ {
			mediatek,clkbuf-config = <0x2 0x1 0x1 0x2 0x0 0x0 0x0>;
			mediatek,clkbuf-driving-current = <0x1 0x1 0x1 0x1 0x1 0x1 0x1>;
			mediatek,clkbuf-quantity = <0x7>;
			status = "okay";
		};
	};

	fragment@33 {
		target = <0xffffffff>;

		__overlay__ {
			#address-cells = <0x1>;
			#size-cells = <0x0>;
			clock-frequency = <0x61a80>;
			mediatek,use-open-drain;
		};
	};

	fragment@34 {
		target = <0xffffffff>;

		__overlay__ {
			#address-cells = <0x1>;
			#size-cells = <0x0>;
			clock-frequency = <0x61a80>;
			mediatek,use-open-drain;
		};
	};

	fragment@35 {
		target = <0xffffffff>;

		__overlay__ {
			#address-cells = <0x1>;
			#size-cells = <0x0>;
			clock-frequency = <0x61a80>;
			mediatek,use-open-drain;

			camera_main@1a {
				compatible = "mediatek,camera_main";
				phandle = <0x4c>;
				reg = <0x1a>;
				status = "okay";
			};

			camera_main_af@0c {
				compatible = "mediatek,camera_main_af";
				phandle = <0x4e>;
				reg = <0xc>;
				status = "okay";
			};

			camera_main_eeprom@50 {
				compatible = "mediatek,camera_main_eeprom";
				phandle = <0x4d>;
				reg = <0x50>;
				status = "okay";
			};

			ccu_sensor_i2c_2_hw@11 {
				compatible = "mediatek,ccu_sensor_i2c_2_hw";
				phandle = <0x4f>;
				reg = <0x11>;
				status = "okay";
			};
		};
	};

	fragment@36 {
		target = <0xffffffff>;

		__overlay__ {
			#address-cells = <0x1>;
			#size-cells = <0x0>;
			clock-frequency = <0x61a80>;
			mediatek,use-open-drain;

			camera_main_two@10 {
				compatible = "mediatek,camera_main_two";
				phandle = <0x51>;
				reg = <0x10>;
				status = "okay";
			};

			camera_main_two_eeprom@50 {
				compatible = "mediatek,camera_main_two_eeprom";
				phandle = <0x52>;
				reg = <0x50>;
				status = "okay";
			};

			nfc@08 {
				compatible = "mediatek,nfc";
				phandle = <0x50>;
				reg = <0x8>;
				status = "okay";
			};
		};
	};

	fragment@37 {
		target = <0xffffffff>;

		__overlay__ {
			#address-cells = <0x1>;
			#size-cells = <0x0>;
			clock-frequency = <0x61a80>;
			mediatek,use-open-drain;

			camera_sub@2d {
				compatible = "mediatek,camera_sub";
				phandle = <0x53>;
				reg = <0x2d>;
				status = "okay";
			};

			camera_sub_eeprom@52 {
				compatible = "mediatek,camera_sub_eeprom";
				phandle = <0x54>;
				reg = <0x52>;
				status = "okay";
			};

			ccu_sensor_i2c_4_hw@12 {
				compatible = "mediatek,ccu_sensor_i2c_4_hw";
				phandle = <0x55>;
				reg = <0x12>;
				status = "okay";
			};
		};
	};

	fragment@38 {
		target = <0xffffffff>;

		__overlay__ {
			#address-cells = <0x1>;
			#size-cells = <0x0>;
			clock-frequency = <0x61a80>;
			mediatek,use-open-drain;

			subpmic_pmu@34 {
				compatible = "mediatek,subpmic_pmu";
				phandle = <0x56>;
				reg = <0x34>;
				status = "okay";
			};

			usb_type_c@4e {
				compatible = "mediatek,usb_type_c";
				phandle = <0x57>;
				reg = <0x4e>;
				status = "okay";
			};
		};
	};

	fragment@39 {
		target = <0xffffffff>;

		__overlay__ {
			#address-cells = <0x1>;
			#size-cells = <0x0>;
			clock-frequency = <0x61a80>;
			mediatek,use-open-drain;
		};
	};

	fragment@4 {
		target = <0xffffffff>;

		__overlay__ {

			fingerprint_default {
				phandle = <0x1>;
			};

			gpio_eint {
				phandle = <0x2>;

				pins_cmd_dat {
					bias-disable;
					pinmux = <0x800>;
					slew-rate = <0x0>;
				};
			};

			gpio_eint_pull_down {
				phandle = <0x3>;

				pins_cmd_dat {
					bias-pull-down = <0x0>;
					output-low;
					pinmux = <0x800>;
					slew-rate = <0x0>;
				};
			};

			rst_out_one {
				phandle = <0x4>;

				pins_cmd_dat {
					bias-disable;
					output-high;
					pinmux = <0x1400>;
					slew-rate = <0x1>;
				};
			};

			rst_out_zero {
				phandle = <0x5>;

				pins_cmd_dat {
					bias-disable;
					output-low;
					pinmux = <0x1400>;
					slew-rate = <0x1>;
				};
			};
		};
	};

	fragment@40 {
		target = <0xffffffff>;

		__overlay__ {
			#address-cells = <0x1>;
			#size-cells = <0x0>;
			clock-frequency = <0x61a80>;
			mediatek,use-open-drain;

			slave_charger@4b {
				compatible = "mediatek,slave_charger";
				phandle = <0x58>;
				reg = <0x4b>;
				status = "okay";
			};
		};
	};

	fragment@41 {
		target = <0xffffffff>;

		__overlay__ {
			#address-cells = <0x1>;
			#size-cells = <0x0>;
			clock-frequency = <0x61a80>;
			mediatek,use-open-drain;
		};
	};

	fragment@42 {
		target = <0xffffffff>;

		__overlay__ {
			GPIO_SIM1_HOT_PLUG = <0xffffffff 0x2f 0x0>;
			GPIO_SIM1_SCLK = <0xffffffff 0xac 0x0>;
			GPIO_SIM1_SIO = <0xffffffff 0xae 0x0>;
			GPIO_SIM1_SRST = <0xffffffff 0xad 0x0>;
			GPIO_SIM2_HOT_PLUG = <0xffffffff 0x2e 0x0>;
			GPIO_SIM2_SCLK = <0xffffffff 0x9d 0x0>;
			GPIO_SIM2_SIO = <0xffffffff 0x9b 0x0>;
			GPIO_SIM2_SRST = <0xffffffff 0x9c 0x0>;
		};
	};

	fragment@43 {
		target = <0xffffffff>;

		__overlay__ {
			gpio_init_default = <0x0 0x0 0x0 0x0 0x1 0x1 0x1 0x1 0x0 0x0 0x0 0x0 0x1 0x1 0x2 0x0 0x0 0x0 0x1 0x0 0x1 0x3 0x0 0x0 0x0 0x1 0x1 0x0 0x4 0x0 0x0 0x0 0x1 0x1 0x1 0x5 0x0 0x0 0x0 0x1 0x0 0x0 0x6 0x0 0x0 0x0 0x1 0x1 0x1 0x7 0x0 0x0 0x0 0x1 0x1 0x0 0x8 0x0 0x0 0x0 0x1 0x1 0x0 0x9 0x0 0x0 0x0 0x1 0x0 0x0 0xa 0x0 0x0 0x0 0x1 0x1 0x0 0xb 0x1 0x0 0x0 0x1 0x0 0x0 0xc 0x2 0x0 0x0 0x1 0x0 0x0 0xd 0x2 0x0 0x0 0x1 0x0 0x0 0xe 0x2 0x1 0x0 0x0 0x0 0x0 0xf 0x2 0x1 0x0 0x0 0x0 0x0 0x10 0x2 0x1 0x0 0x0 0x0 0x0 0x11 0x0 0x0 0x0 0x1 0x0 0x1 0x12 0x0 0x0 0x0 0x1 0x1 0x1 0x13 0x0 0x1 0x0 0x1 0x0 0x1 0x14 0x0 0x1 0x0 0x1 0x0 0x1 0x15 0x0 0x0 0x0 0x1 0x1 0x0 0x16 0x0 0x0 0x0 0x1 0x0 0x0 0x17 0x0 0x0 0x0 0x0 0x0 0x0 0x18 0x5 0x0 0x0 0x1 0x0 0x0 0x19 0x2 0x0 0x0 0x1 0x0 0x0 0x1a 0x2 0x0 0x0 0x0 0x0 0x0 0x1b 0x2 0x1 0x0 0x0 0x0 0x0 0x1c 0x2 0x0 0x0 0x0 0x0 0x0 0x1d 0x0 0x1 0x0 0x0 0x0 0x0 0x1e 0x0 0x1 0x0 0x0 0x0 0x0 0x1f 0x0 0x1 0x0 0x1 0x1 0x0 0x20 0x1 0x0 0x0 0x1 0x0 0x0 0x21 0x1 0x1 0x0 0x0 0x0 0x0 0x22 0x1 0x1 0x0 0x0 0x0 0x0 0x23 0x1 0x1 0x0 0x0 0x0 0x0 0x24 0x0 0x1 0x0 0x0 0x0 0x0 0x25 0x2 0x1 0x0 0x0 0x0 0x0 0x26 0x0 0x0 0x0 0x0 0x0 0x1 0x27 0x0 0x0 0x0 0x1 0x1 0x1 0x28 0x2 0x0 0x0 0x1 0x0 0x0 0x29 0x0 0x0 0x0 0x1 0x1 0x1 0x2a 0x0 0x1 0x0 0x1 0x1 0x1 0x2b 0x1 0x1 0x0 0x0 0x0 0x0 0x2c 0x1 0x0 0x0 0x1 0x0 0x0 0x2d 0x0 0x1 0x0 0x0 0x0 0x0 0x2e 0x1 0x0 0x0 0x1 0x1 0x0 0x2f 0x1 0x0 0x0 0x1 0x1 0x0 0x30 0x1 0x0 0x0 0x1 0x1 0x1 0x31 0x1 0x0 0x0 0x1 0x1 0x1 0x32 0x1 0x0 0x0 0x1 0x1 0x1 0x33 0x1 0x0 0x0 0x1 0x1 0x1 0x34 0x1 0x0 0x0 0x1 0x0 0x0 0x35 0x1 0x0 0x0 0x1 0x0 0x0 0x36 0x1 0x0 0x0 0x1 0x0 0x0 0x37 0x1 0x0 0x0 0x1 0x0 0x0 0x38 0x1 0x0 0x0 0x1 0x0 0x0 0x39 0x1 0x0 0x0 0x1 0x0 0x0 0x3a 0x0 0x0 0x0 0x1 0x0 0x0 0x3b 0x1 0x0 0x0 0x1 0x0 0x0 0x3c 0x1 0x0 0x0 0x1 0x0 0x0 0x3d 0x1 0x0 0x0 0x1 0x0 0x0 0x3e 0x1 0x0 0x0 0x1 0x0 0x0 0x3f 0x1 0x0 0x0 0x1 0x0 0x0 0x40 0x1 0x0 0x0 0x1 0x0 0x0 0x41 0x1 0x0 0x0 0x1 0x0 0x0 0x42 0x1 0x0 0x0 0x1 0x0 0x0 0x43 0x1 0x0 0x0 0x1 0x0 0x0 0x44 0x1 0x0 0x0 0x1 0x0 0x0 0x45 0x1 0x0 0x0 0x1 0x0 0x0 0x46 0x1 0x0 0x0 0x1 0x0 0x0 0x47 0x1 0x0 0x0 0x1 0x0 0x0 0x48 0x1 0x0 0x0 0x1 0x0 0x0 0x49 0x1 0x0 0x0 0x1 0x0 0x0 0x4a 0x1 0x0 0x0 0x1 0x0 0x0 0x4b 0x1 0x0 0x0 0x1 0x0 0x0 0x4c 0x1 0x0 0x0 0x1 0x0 0x0 0x4d 0x1 0x0 0x0 0x1 0x0 0x0 0x4e 0x1 0x0 0x0 0x1 0x0 0x0 0x4f 0x0 0x0 0x0 0x1 0x0 0x0 0x50 0x0 0x0 0x0 0x1 0x0 0x0 0x51 0x2 0x0 0x0 0x1 0x1 0x1 0x52 0x1 0x0 0x0 0x1 0x1 0x1 0x53 0x1 0x0 0x0 0x1 0x1 0x1 0x54 0x2 0x0 0x0 0x1 0x1 0x1 0x55 0x2 0x0 0x0 0x1 0x0 0x0 0x56 0x2 0x1 0x0 0x0 0x0 0x0 0x57 0x2 0x1 0x0 0x0 0x0 0x0 0x58 0x2 0x1 0x0 0x0 0x0 0x0 0x59 0x1 0x0 0x0 0x1 0x1 0x1 0x5a 0x1 0x0 0x0 0x1 0x1 0x1 0x5b 0x0 0x0 0x0 0x0 0x0 0x0 0x5c 0x1 0x1 0x0 0x0 0x0 0x0 0x5d 0x1 0x0 0x0 0x1 0x1 0x0 0x5e 0x0 0x1 0x0 0x0 0x0 0x0 0x5f 0x1 0x0 0x0 0x1 0x1 0x0 0x60 0x1 0x1 0x0 0x0 0x0 0x0 0x61 0x0 0x0 0x0 0x1 0x1 0x0 0x62 0x0 0x0 0x0 0x1 0x0 0x0 0x63 0x1 0x1 0x0 0x0 0x0 0x0 0x64 0x1 0x1 0x0 0x0 0x0 0x0 0x65 0x0 0x1 0x0 0x0 0x0 0x0 0x66 0x0 0x1 0x0 0x0 0x0 0x0 0x67 0x1 0x0 0x0 0x1 0x1 0x1 0x68 0x1 0x0 0x0 0x1 0x1 0x1 0x69 0x1 0x0 0x0 0x1 0x1 0x1 0x6a 0x1 0x0 0x0 0x1 0x1 0x1 0x6b 0x0 0x0 0x0 0x0 0x1 0x0 0x6c 0x0 0x0 0x0 0x0 0x0 0x0 0x6d 0x0 0x1 0x0 0x0 0x0 0x0 0x6e 0x0 0x1 0x0 0x0 0x0 0x0 0x6f 0x1 0x1 0x0 0x0 0x0 0x0 0x70 0x0 0x0 0x0 0x0 0x0 0x0 0x71 0x0 0x0 0x0 0x1 0x0 0x0 0x72 0x0 0x0 0x0 0x1 0x0 0x0 0x73 0x0 0x0 0x0 0x1 0x0 0x0 0x74 0x0 0x0 0x0 0x1 0x0 0x0 0x75 0x0 0x0 0x0 0x1 0x0 0x0 0x76 0x0 0x0 0x0 0x1 0x0 0x0 0x77 0x0 0x0 0x0 0x1 0x0 0x0 0x78 0x0 0x0 0x0 0x1 0x0 0x0 0x79 0x0 0x0 0x0 0x1 0x0 0x0 0x86 0x1 0x0 0x0 0x1 0x0 0x1 0x87 0x1 0x1 0x0 0x0 0x0 0x0 0x88 0x1 0x1 0x0 0x0 0x0 0x0 0x89 0x1 0x1 0x0 0x0 0x0 0x0 0x8a 0x1 0x1 0x0 0x0 0x0 0x0 0x8b 0x1 0x1 0x0 0x0 0x0 0x0 0x8c 0x1 0x0 0x0 0x1 0x0 0x0 0x8d 0x1 0x0 0x0 0x1 0x0 0x0 0x8e 0x1 0x0 0x0 0x1 0x0 0x0 0x8f 0x1 0x0 0x0 0x1 0x0 0x0 0x90 0x1 0x0 0x0 0x1 0x0 0x0 0x91 0x1 0x1 0x0 0x0 0x0 0x0 0x92 0x1 0x1 0x0 0x0 0x0 0x0 0x93 0x1 0x1 0x0 0x0 0x0 0x0 0x94 0x1 0x1 0x0 0x0 0x0 0x0 0x95 0x1 0x1 0x0 0x0 0x0 0x0 0x96 0x0 0x1 0x0 0x0 0x0 0x0 0x97 0x4 0x1 0x0 0x0 0x0 0x0 0x98 0x0 0x1 0x0 0x0 0x0 0x0 0x99 0x0 0x1 0x0 0x0 0x0 0x0 0x9a 0x1 0x1 0x0 0x0 0x0 0x0 0x9b 0x1 0x0 0x0 0x1 0x1 0x0 0x9c 0x1 0x1 0x0 0x0 0x0 0x0 0x9d 0x1 0x1 0x0 0x0 0x0 0x0 0x9e 0x0 0x1 0x0 0x0 0x0 0x0 0x9f 0x0 0x1 0x0 0x0 0x0 0x0 0xa0 0x0 0x1 0x0 0x1 0x1 0x0 0xa1 0x1 0x0 0x0 0x1 0x1 0x1 0xa2 0x1 0x0 0x0 0x1 0x1 0x1 0xa3 0x1 0x0 0x0 0x1 0x1 0x1 0xa4 0x1 0x0 0x0 0x1 0x1 0x1 0xa5 0x0 0x1 0x0 0x0 0x0 0x0 0xa6 0x0 0x1 0x0 0x0 0x0 0x0 0xa7 0x1 0x0 0x0 0x1 0x0 0x0 0xa8 0x1 0x0 0x0 0x1 0x0 0x0 0xa9 0x0 0x1 0x0 0x0 0x0 0x0 0xaa 0x1 0x0 0x0 0x1 0x1 0x1 0xab 0x1 0x1 0x0 0x0 0x0 0x1 0xac 0x1 0x1 0x0 0x0 0x0 0x0 0xad 0x1 0x1 0x0 0x0 0x0 0x0 0xae 0x1 0x0 0x0 0x1 0x1 0x0 0xaf 0x1 0x0 0x0 0x1 0x1 0x1 0xb0 0x1 0x0 0x0 0x1 0x1 0x1 0xb2 0x0 0x1 0x0 0x0 0x0 0x0 0xb3 0x0 0x1 0x0 0x0 0x0 0x0 0xb4 0x0 0x0 0x0 0x1 0x0 0x0 0xb5 0x0 0x0 0x0 0x1 0x0 0x0 0xb6 0x0 0x0 0x0 0x1 0x0 0x0 0xb7 0x0 0x0 0x0 0x1 0x0 0x0 0xb8 0x0 0x0 0x0 0x1 0x0 0x0 0xb9 0x0 0x0 0x0 0x1 0x0 0x0 0xba 0x0 0x0 0x0 0x1 0x0 0x0>;
		};
	};

	fragment@44 {
		target = <0xffffffff>;

		__overlay__ {
			deb-gpios = <0xffffffff 0x0 0x0>;
			debounce = <0x7d000>;
			interrupt-parent = <0xffffffff>;
			interrupts = <0x0 0x8 0x0 0x0>;
			status = "okay";
		};
	};

	fragment@45 {
		target = <0xffffffff>;

		__overlay__ {
			interrupt-parent = <0xffffffff>;
			interrupts = <0x1 0x2 0x1 0x0>;
			status = "okay";
		};
	};

	fragment@46 {
		target = <0xffffffff>;

		__overlay__ {
			deb-gpios = <0xffffffff 0x4 0x0>;
			debounce = <0x186a0>;
			interrupt-parent = <0xffffffff>;
			interrupts = <0x4 0x4 0x4 0x0>;
			status = "okay";
		};
	};

	fragment@47 {
		target = <0xffffffff>;

		__overlay__ {
			interrupt-parent = <0xffffffff>;
			interrupts = <0x9 0x4 0x9 0x0>;
			status = "okay";
		};
	};

	fragment@48 {
		target = <0xffffffff>;

		__overlay__ {
			interrupt-parent = <0xffffffff>;
			interrupts = <0x14 0x2 0x14 0x0>;
			status = "okay";
		};
	};

	fragment@49 {
		target = <0xffffffff>;

		__overlay__ {
			interrupt-parent = <0xffffffff>;
			interrupts = <0x27 0x8 0x27 0x0>;
			status = "okay";
		};
	};

	fragment@5 {
		target = <0xffffffff>;

		__overlay__ {

			led@0 {
				compatible = "mediatek,red";
				data = <0x1>;
				led_mode = <0x0>;
				phandle = <0x3f>;
				pwm_config = <0x0 0x0 0x0 0x0 0x0>;
			};

			led@1 {
				compatible = "mediatek,green";
				data = <0x1>;
				led_mode = <0x0>;
				phandle = <0x40>;
				pwm_config = <0x0 0x0 0x0 0x0 0x0>;
			};

			led@2 {
				compatible = "mediatek,blue";
				data = <0x1>;
				led_mode = <0x0>;
				phandle = <0x41>;
				pwm_config = <0x0 0x0 0x0 0x0 0x0>;
			};

			led@3 {
				compatible = "mediatek,jogball-backlight";
				data = <0x1>;
				led_mode = <0x0>;
				phandle = <0x42>;
				pwm_config = <0x0 0x0 0x0 0x0 0x0>;
			};

			led@4 {
				compatible = "mediatek,keyboard-backlight";
				data = <0x1>;
				led_mode = <0x0>;
				phandle = <0x43>;
				pwm_config = <0x0 0x0 0x0 0x0 0x0>;
			};

			led@5 {
				compatible = "mediatek,button-backlight";
				data = <0x1>;
				led_mode = <0x0>;
				phandle = <0x44>;
				pwm_config = <0x0 0x0 0x0 0x0 0x0>;
			};

			led@6 {
				compatible = "mediatek,lcd-backlight";
				data = <0x1>;
				led_mode = <0x5>;
				phandle = <0x45>;
				pwm_config = <0x0 0x0 0x0 0x0 0x0>;
			};

			swtp {
				compatible = "mediatek, swtp-eint";
				deb-gpios = <0xffffffff 0x3 0x0>;
				debounce = <0x3e800>;
				interrupt-parent = <0xffffffff>;
				interrupts = <0x3 0x8 0x3 0x0>;
				phandle = <0x48>;
				status = "okay";
			};

			tran_battery {
				compatible = "tran,chg_fun";
				jeita_above_t4_chg_cur = <0x0>;
				jeita_above_t4_input_cur = <0xf4240>;
				jeita_below_t0_chg_cur = <0x0>;
				jeita_below_t0_input_cur = <0xdbba0>;
				jeita_t0_to_t1_chg_cur = <0xdbba0>;
				jeita_t0_to_t1_input_cur = <0xdbba0>;
				jeita_t2_to_t3_chg_cur = <0x2191c0>;
				jeita_t2_to_t3_input_cur = <0x1e8480>;
				jeita_t3_to_t4_chg_cur = <0x2191c0>;
				jeita_t3_to_t4_input_cur = <0x2191c0>;
				phandle = <0x47>;
			};

			vibrator@0 {
				compatible = "mediatek,vibrator";
				phandle = <0x46>;
				vib_limit = <0x9>;
				vib_timer = <0x19>;
				vib_vol = <0xb>;
			};
		};
	};

	fragment@50 {
		target = <0xffffffff>;

		__overlay__ {
			interrupt-parent = <0xffffffff>;
			interrupts = <0x2a 0x2 0x2a 0x0>;
			status = "okay";
		};
	};

	fragment@51 {
		target = <0xffffffff>;

		__overlay__ {
			interrupt-parent = <0xffffffff>;
			interrupts = <0x2c 0x1 0x2c 0x1>;
			status = "okay";
		};
	};

	fragment@52 {
		target = <0xffffffff>;

		__overlay__ {
			interrupt-parent = <0xffffffff>;
			interrupts = <0x90 0x4 0xb4 0x0>;
			status = "okay";
		};
	};

	fragment@53 {
		target = <0xffffffff>;

		__overlay__ {
			compatible = "mediatek,md1_sim1_hot_plug_eint-eint";
			debounce = <0x0 0x2710>;
			dedicated = <0x0 0x0>;
			interrupts = <0x0 0x8>;
			sockettype = <0x0 0x0>;
			src_pin = <0x0 0x1>;
			status = "okay";
		};
	};

	fragment@54 {
		target = <0xffffffff>;

		__overlay__ {
			compatible = "mediatek,md1_sim2_hot_plug_eint-eint";
			debounce = <0x1 0x2710>;
			dedicated = <0x1 0x0>;
			interrupts = <0x1 0x8>;
			sockettype = <0x1 0x0>;
			src_pin = <0x1 0x2>;
			status = "okay";
		};
	};

	fragment@55 {
		target = <0xffffffff>;

		__overlay__ {
			regulator-default-on = <0x1>;
			regulator-name = "vcama1";
			status = "okay";
		};
	};

	fragment@56 {
		target = <0xffffffff>;

		__overlay__ {
			regulator-default-on = <0x1>;
			regulator-name = "vcama2";
			status = "okay";
		};
	};

	fragment@57 {
		target = <0xffffffff>;

		__overlay__ {
			regulator-default-on = <0x1>;
			regulator-name = "vsim1";
			status = "okay";
		};
	};

	fragment@58 {
		target = <0xffffffff>;

		__overlay__ {
			regulator-default-on = <0x1>;
			regulator-name = "vsim2";
			status = "okay";
		};
	};

	fragment@59 {
		target = <0xffffffff>;

		__overlay__ {
			regulator-default-on = <0x1>;
			regulator-name = "vcamd";
			status = "okay";
		};
	};

	fragment@6 {
		target = <0xffffffff>;

		__overlay__ {
			clock-frequency = <0x186a0>;

			ocp2138@3e {
				compatible = "ocp2138";
				reg = <0x3e>;
				status = "okay";
			};
		};
	};

	fragment@60 {
		target = <0xffffffff>;

		__overlay__ {
			regulator-default-on = <0x1>;
			regulator-name = "vcamio";
			status = "okay";
		};
	};

	fragment@61 {
		target = <0xffffffff>;

		__overlay__ {
			regulator-default-on = <0x1>;
			regulator-name = "vldo28";
			status = "okay";
		};
	};

	fragment@62 {
		target = <0xffffffff>;

		__overlay__ {
			status = "okay";
			vcama-supply = <0xffffffff>;
			vcama_main2-supply = <0xffffffff>;
			vcama_sub-supply = <0xffffffff>;
			vcamaf-supply = <0xffffffff>;
			vcamaf_main2-supply = <0xffffffff>;
			vcamaf_sub-supply = <0xffffffff>;
			vcamd_main2-supply = <0xffffffff>;
			vcamio-supply = <0xffffffff>;
			vcamio_main2-supply = <0xffffffff>;
			vcamio_sub-supply = <0xffffffff>;
		};
	};

	fragment@63 {
		target = <0xffffffff>;

		__overlay__ {
			status = "okay";
			vtouch-supply = <0xffffffff>;
		};
	};

	fragment@64 {
		target = <0xffffffff>;

		__overlay__ {
			mediatek,kpd-hw-dl-key0 = <0x11>;
			mediatek,kpd-hw-dl-key1 = <0x0>;
			mediatek,kpd-hw-dl-key2 = <0x8>;
			mediatek,kpd-hw-factory-key = <0x0>;
			mediatek,kpd-hw-init-map = <0x72 0x0 0x0 0x0 0x0 0x0 0x0 0x0 0x0 0x0 0x0 0x0 0x0 0x0 0x0 0x0 0x0 0x0 0x0 0x0 0x0 0x0 0x0 0x0 0x0 0x0 0x0 0x0 0x0 0x0 0x0 0x0 0x0 0x0 0x0 0x0 0x0 0x0 0x0 0x0 0x0 0x0 0x0 0x0 0x0 0x0 0x0 0x0 0x0 0x0 0x0 0x0 0x0 0x0 0x0 0x0 0x0 0x0 0x0 0x0 0x0 0x0 0x0 0x0 0x0 0x0 0x0 0x0 0x0 0x0 0x0 0x0>;
			mediatek,kpd-hw-map-num = <0x48>;
			mediatek,kpd-hw-pwrkey = <0x8>;
			mediatek,kpd-hw-recovery-key = <0x11>;
			mediatek,kpd-hw-rstkey = <0x11>;
			mediatek,kpd-key-debounce = <0x400>;
			mediatek,kpd-pwkey-gpio-din = <0x0>;
			mediatek,kpd-pwrkey-eint-gpio = <0x0>;
			mediatek,kpd-sw-pwrkey = <0x74>;
			mediatek,kpd-sw-rstkey = <0x73>;
			mediatek,kpd-use-extend-type = <0x0>;
			status = "okay";
		};
	};

	fragment@65 {
		target = <0xffffffff>;

		__overlay__ {

			ocp81375default {
				phandle = <0x22>;
			};

			ocp81375hwen_high {
				phandle = <0x23>;

				pins_cmd_dat {
					output-high;
					pinmux = <0x9600>;
					slew-rate = <0x1>;
				};
			};

			ocp81375hwen_low {
				phandle = <0x24>;

				pins_cmd_dat {
					output-low;
					pinmux = <0x9600>;
					slew-rate = <0x1>;
				};
			};
		};
	};

	fragment@66 {
		target = <0xffffffff>;

		__overlay__ {
			pinctrl-0 = <0x22>;
			pinctrl-1 = <0x23>;
			pinctrl-2 = <0x24>;
			pinctrl-names = "default", "hwen_high", "hwen_low";
			status = "okay";
		};
	};

	fragment@67 {
		target = <0xffffffff>;

		__overlay__ {

			camdefault {
				phandle = <0x25>;
			};

			camera0_mclk_2mA@gpio99 {
				phandle = <0x31>;

				pins_cmd_dat {
					drive-strength = <0x2>;
					pinmux = <0x6301>;
				};
			};

			camera0_mclk_4mA@gpio99 {
				phandle = <0x32>;

				pins_cmd_dat {
					drive-strength = <0x4>;
					pinmux = <0x6301>;
				};
			};

			camera0_mclk_6mA@gpio99 {
				phandle = <0x33>;

				pins_cmd_dat {
					drive-strength = <0x6>;
					pinmux = <0x6301>;
				};
			};

			camera0_mclk_8mA@gpio99 {
				phandle = <0x34>;

				pins_cmd_dat {
					drive-strength = <0x7>;
					pinmux = <0x6301>;
				};
			};

			camera0_mclk_gpio_mode@gpio99 {
				phandle = <0x30>;

				pins_cmd_dat {
					drive-strength = <0x4>;
					pinmux = <0x6300>;
				};
			};

			camera0_rst_output_high@gpio101 {
				phandle = <0x27>;

				pins_cmd_dat {
					output-high;
					pinmux = <0x6500>;
				};
			};

			camera0_rst_output_low@gpio101 {
				phandle = <0x26>;

				pins_cmd_dat {
					output-low;
					pinmux = <0x6500>;
				};
			};

			camera0_vcamd_output_high@gpio179 {
				phandle = <0x2e>;

				pins_cmd_dat {
					output-high;
					pinmux = <0xb300>;
				};
			};

			camera0_vcamd_output_low@gpio179 {
				phandle = <0x2f>;

				pins_cmd_dat {
					output-low;
					pinmux = <0xb300>;
				};
			};

			camera1_mclk_2mA@gpio100 {
				phandle = <0x36>;

				pins_cmd_dat {
					drive-strength = <0x2>;
					pinmux = <0x6401>;
				};
			};

			camera1_mclk_4mA@gpio100 {
				phandle = <0x37>;

				pins_cmd_dat {
					drive-strength = <0x4>;
					pinmux = <0x6401>;
				};
			};

			camera1_mclk_6mA@gpio100 {
				phandle = <0x38>;

				pins_cmd_dat {
					drive-strength = <0x6>;
					pinmux = <0x6401>;
				};
			};

			camera1_mclk_8mA@gpio100 {
				phandle = <0x39>;

				pins_cmd_dat {
					drive-strength = <0x7>;
					pinmux = <0x6401>;
				};
			};

			camera1_mclk_gpio_mode@gpio100 {
				phandle = <0x35>;

				pins_cmd_dat {
					drive-strength = <0x4>;
					pinmux = <0x6400>;
				};
			};

			camera1_rst_output_high@gpio102 {
				phandle = <0x29>;

				pins_cmd_dat {
					output-high;
					pinmux = <0x6600>;
				};
			};

			camera1_rst_output_low@gpio102 {
				phandle = <0x28>;

				pins_cmd_dat {
					output-low;
					pinmux = <0x6600>;
				};
			};

			camera2_mclk_2mA@gpio111 {
				phandle = <0x3b>;

				pins_cmd_dat {
					drive-strength = <0x2>;
					pinmux = <0x6f01>;
				};
			};

			camera2_mclk_4mA@gpio111 {
				phandle = <0x3c>;

				pins_cmd_dat {
					drive-strength = <0x4>;
					pinmux = <0x6f01>;
				};
			};

			camera2_mclk_6mA@gpio111 {
				phandle = <0x3d>;

				pins_cmd_dat {
					drive-strength = <0x6>;
					pinmux = <0x6f01>;
				};
			};

			camera2_mclk_8mA@gpio111 {
				phandle = <0x3e>;

				pins_cmd_dat {
					drive-strength = <0x7>;
					pinmux = <0x6f01>;
				};
			};

			camera2_mclk_gpio_mode@gpio111 {
				phandle = <0x3a>;

				pins_cmd_dat {
					drive-strength = <0x4>;
					pinmux = <0x6f00>;
				};
			};

			camera2_pdn_output_high@gpio110 {
				phandle = <0x2d>;

				pins_cmd_dat {
					output-high;
					pinmux = <0x6e00>;
				};
			};

			camera2_pdn_output_low@gpio110 {
				phandle = <0x2c>;

				pins_cmd_dat {
					output-low;
					pinmux = <0x6e00>;
				};
			};

			camera2_rst_output_high@gpio109 {
				phandle = <0x2b>;

				pins_cmd_dat {
					output-high;
					pinmux = <0x6d00>;
				};
			};

			camera2_rst_output_low@gpio109 {
				phandle = <0x2a>;

				pins_cmd_dat {
					output-low;
					pinmux = <0x6d00>;
				};
			};
		};
	};

	fragment@68 {
		target = <0xffffffff>;

		__overlay__ {
			cam0_enable_sensor = "s5kjn1_st_mipi_raw hi5021q_st_mipi_raw hi5021q_stki7_mipi_raw";
			cam0_vcama-supply = <0xffffffff>;
			cam0_vcamio-supply = <0xffffffff>;
			cam1_enable_sensor = "s5kgd2sp_mipi_raw s5kgd2_mipi_raw ov8856ff_mipi_raw gc08a3_mipi_raw";
			cam1_vcama-supply = <0xffffffff>;
			cam1_vcamd-supply = <0xffffffff>;
			cam1_vcamio-supply = <0xffffffff>;
			cam2_enable_sensor = "fake_serial_yuv";
			cam2_vcama-supply = <0xffffffff>;
			pinctrl-0 = <0x25>;
			pinctrl-1 = <0x26>;
			pinctrl-10 = <0x2f>;
			pinctrl-11 = <0x30>;
			pinctrl-12 = <0x31>;
			pinctrl-13 = <0x32>;
			pinctrl-14 = <0x33>;
			pinctrl-15 = <0x34>;
			pinctrl-16 = <0x35>;
			pinctrl-17 = <0x36>;
			pinctrl-18 = <0x37>;
			pinctrl-19 = <0x38>;
			pinctrl-2 = <0x27>;
			pinctrl-20 = <0x39>;
			pinctrl-21 = <0x3a>;
			pinctrl-22 = <0x3b>;
			pinctrl-23 = <0x3c>;
			pinctrl-24 = <0x3d>;
			pinctrl-25 = <0x3e>;
			pinctrl-3 = <0x28>;
			pinctrl-4 = <0x29>;
			pinctrl-5 = <0x2a>;
			pinctrl-6 = <0x2b>;
			pinctrl-7 = <0x2c>;
			pinctrl-8 = <0x2d>;
			pinctrl-9 = <0x2e>;
			pinctrl-names = "default", "cam0_rst0", "cam0_rst1", "cam1_rst0", "cam1_rst1", "cam2_rst0", "cam2_rst1", "cam2_pnd0", "cam2_pnd1", "cam0_vcamd_on", "cam0_vcamd_off", "cam0_mclk_off", "cam0_mclk_2mA", "cam0_mclk_4mA", "cam0_mclk_6mA", "cam0_mclk_8mA", "cam1_mclk_off", "cam1_mclk_2mA", "cam1_mclk_4mA", "cam1_mclk_6mA", "cam1_mclk_8mA", "cam2_mclk_off", "cam2_mclk_2mA", "cam2_mclk_4mA", "cam2_mclk_6mA", "cam2_mclk_8mA";
			status = "okay";
		};
	};

	fragment@69 {
		target = <0xffffffff>;

		__overlay__ {
			camaf_m1_pmic-supply = <0xffffffff>;
			camaf_m2_pmic-supply = <0xffffffff>;
			camaf_m3_pmic-supply = <0xffffffff>;
			status = "okay";
		};
	};

	fragment@7 {
		target = <0xffffffff>;

		__overlay__ {
			status = "ok";

			abov_sar@20 {
				abov,irq-gpio-std = <0xffffffff 0x6 0x2>;
				cap,firmware_name = "AbovCapSense";
				cap,use_channel_ch0 = <0x0>;
				cap,use_channel_ch1 = <0x1>;
				cap,use_channel_ch2 = <0x2>;
				cap_svdd-supply = <0xffffffff>;
				cap_vdd-supply = <0xffffffff>;
				ch0_name = "aw_sar0_ch0";
				ch1_name = "aw_sar0_ch2";
				ch2_name = "aw_sar0_ch3";
				compatible = "abov,abov_sar";
				reg = <0x20>;
				reg_array_len = <0x3>;
				reg_array_val = <0x7 0x0 0x8 0x1f 0xfb 0x1>;
				status = "ok";
			};
		};
	};

	fragment@8 {
		target = <0xffffffff>;

		__overlay__ {
			#address-cells = <0x1>;
			#size-cells = <0x0>;
			pinctrl-0 = <0x6>;
			pinctrl-names = "default";
			status = "okay";

			spislv@0 {
				compatible = "mediatek,spi_slave";
				high-speed-early-trans = [00];
				high-speed-tick-delay = [02];
				low-speed-early-trans = [00];
				low-speed-tick-delay = [04];
				reg = <0x0>;
				slave-drive-strength = [03];
				spi-max-frequency = <0x3473bc0>;
				spi-rx-bus-width = <0x1>;
				spi-tx-bus-width = <0x1>;
			};
		};
	};

	fragment@9 {
		target = <0xffffffff>;

		__overlay__ {

			spislv_mode_default {
				phandle = <0x6>;

				pins_cmd_dat {
					drive-strength = <0x3>;
					pinmux = <0xd02 0xf02 0x1002 0xe02>;
				};
			};
		};
	};
};
